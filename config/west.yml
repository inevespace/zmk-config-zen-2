## config/west.yml
```yaml
manifest:
  remotes:
    - name: zmkfirmware
      url-base: https://github.com/zmkfirmware
    - name: caksoylar
      url-base: https://github.com/caksoylar
    - name: urob
      url-base: https://github.com/urob
  projects:
    - name: zmk
      remote: caksoylar
      revision: caksoylar/zen-v1+v2  # custom branch name   
#      remote: zmkfirmware
#      revision: main
    - name: zmk-auto-layer
      remote: urob
      revision: v0.2 # set to same version as zmk above
      import: app/west.yml
  self:
    path: config
 
```
